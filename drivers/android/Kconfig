## drivers/android/Kconfig
```kconfig
menu "Android"

config ANDROID
	bool "Android Drivers"
	default N
	---help---
	  Enable support for various drivers needed on the Android platform

if ANDROID

config ANDROID_BINDER_IPC
        bool "Android Binder IPC Driver"
        default n
        ---help---
          Binder is used in Android for both communication between processes,
          and remote method invocation.

          This means one Android process can call a method/routine in another
          Android process, using Binder to identify, invoke and pass arguments
          between said processes.

config ANDROID_BINDER_DEVICES
        string "Android Binder devices"
        depends on ANDROID_BINDER_IPC
        default "binder,hwbinder"
        ---help---
          Default value for the binder.devices parameter.

endif # if ANDROID

endmenu
```

## drivers/input/touchscreen/msg28xx/Kconfig
```kconfig
#
# Mstar msg28xx for haier b16c2h
#
menuconfig TOUCHSCREEN_MSG28XX
	bool "Mstar msg28xx touchscreen"
	help
	  Say Y here if you have a Mstar MSG28XX touchscreen connected
	  to your system.

	  If unsure, say N.
```

## drivers/platform/haier/Kconfig
```kconfig
# Haier configuration options

config MACH_HAIER
	bool "Haier device"
	depends on ARCH_MSM
	help
	  Support for Haier products

config MACH_HAIER_MSM8909
	bool "Haier MSM8909"
	depends on ARCH_MSM8909
	select MACH_HAIER
	help
	  Support for MSM8909 Haier variants

config MACH_HAIER_MSM8916
	bool "Haier MSM8916"
	depends on ARCH_MSM8916
	select MACH_HAIER
	help
	  Support for MSM8916 Haier variants

menu "Haier board selection"

config MACH_G151
	bool "G151 board"
	select MACH_HAIER_MSM8909
	help
	  Support for Haier G151 variant

config MACH_RENDANG
	bool "Rendang board"
	select MACH_HAIER_MSM8916
	help
	  Support for Haier Rendang variant

endmenu
```
